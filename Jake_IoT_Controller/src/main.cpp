#include "thingProperties.h" // Arduino IoT Cloud 라이브러리
#include <Arduino.h>
#include <NeoPixelConnect.h>  // NeoPixel LED 라이브러리
#include <DHT.h>              // DHT 온습도 센서 라이브러리
#include <Adafruit_GFX.h>     // Adafruit 그래픽 라이브러리 (OLED 디스플레이 지원)
#include <Adafruit_SSD1306.h> // Adafruit OLED 디스플레이 라이브러리
#include <BH1750.h>           // BH1750 조도 센서 라이브러리
#include <WiFiNINA.h>

#define DEBUG_MODE_ENABLE 0

// NeoPixel LED 설정
#define PIXEL_CONTROL_PIN 15
#define MAXIMUM_NUM_NEOPIXELS 12

// DHT 온습도 센서 설정
#define DHT_PIN 2
#define DHTTYPE DHT11

// OLED 디스플레이 설정
#define SCREEN_WIDTH 128
#define SCREEN_HEIGHT 32
#define OLED_RESET -1
#define SCREEN_ADDRESS 0x3C

// 초기 화면 표시 시간 (5초 동안 초기 화면 표시 후 센서 데이터 표시)
const long displayDelay = 5000;

// 전역 변수 선언
unsigned char redColor = 0, greenColor = 0, blueColor = 0;
bool flgEmotionalModeEnable = true;
bool flgInitialDisplayDone = false;
unsigned long previousMillis = 0;
double hue, saturation, value;
void rgb_to_hsv(double r, double g, double b);

unsigned long lastCloudUpdate = 0;
const unsigned long cloudUpdateInterval = 100; // 100ms 간격으로 업데이트

// OLED 초기 화면 비트맵 데이터 (로고나 초기 화면 이미지)
static const unsigned char epd_bitmap_oled_background[] PROGMEM = {
    0x00, 0x00, 0x00, 0x00, 0x00, 0x00, 0x00, 0x00, 0x00, 0x00, 0x00, 0x00, 0x00, 0x00, 0x00, 0x00,
    0x00, 0x00, 0x00, 0x00, 0x01, 0x80, 0x00, 0x80, 0x00, 0x01, 0xa0, 0x00, 0x00, 0x00, 0x00, 0x00,
    0x00, 0x00, 0x00, 0x01, 0xfd, 0x83, 0xfc, 0x80, 0x18, 0xf9, 0xb3, 0xfe, 0x00, 0x00, 0x00, 0x00,
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    0x00, 0x00, 0x00, 0x00, 0x00, 0x00, 0x00, 0x00, 0x00, 0x00, 0x00, 0x00, 0x00, 0x00, 0x00, 0x00};

// 객체 생성 (NeoPixel, DHT 센서, OLED 디스플레이)
NeoPixelConnect myLEDStrip(PIXEL_CONTROL_PIN, MAXIMUM_NUM_NEOPIXELS, pio0, 0);
DHT myDHT(DHT_PIN, DHTTYPE);
Adafruit_SSD1306 myOledDisplay(SCREEN_WIDTH, SCREEN_HEIGHT, &Wire, OLED_RESET);
BH1750 lightMeter;

// 함수 선언 (프로토타이핑)
void initializeOLED();
void displaySensorData(float temperature, float humidity, float lightLevel);
void sendHSV_ColorDataToCloud(void);

// 초기 설정 함수 (한 번만 실행)
void setup()
{
  Serial.begin(115200);
  Wire.begin();
  myDHT.begin();
  lightMeter.begin(BH1750::CONTINUOUS_HIGH_RES_MODE);

  initProperties();
  ArduinoCloud.begin(ArduinoIoTPreferredConnection);
  initializeOLED();
}

// 메인 루프 (계속 반복 실행)
void loop()
{
  unsigned long currentMillis = millis();
  if (currentMillis - lastCloudUpdate >= cloudUpdateInterval)
  {
    ArduinoCloud.update();
    lastCloudUpdate = currentMillis;
  }

  if (!flgInitialDisplayDone && currentMillis - previousMillis >= displayDelay)
  {
    flgInitialDisplayDone = true;
    myOledDisplay.clearDisplay();
  }

  if (flgInitialDisplayDone)
  {
    fHumidity = myDHT.readHumidity();
    fTemperature = myDHT.readTemperature();
    fLightBrightness = lightMeter.readLightLevel();

#if (DEBUG_MODE_ENABLE == 1)
    Serial.print("Humidity: ");
    Serial.print(fHumidity);
    Serial.print("%   Temperature: ");
    Serial.print(fTemperature);
    Serial.print("^C   Light: ");
    Serial.print(fLightBrightness);
    Serial.println(" lx");
#endif

    // 온습도 및 조도 값 OLED에 표시
    displaySensorData(fTemperature, fHumidity, fLightBrightness);

    // 온도에 따라 NeoPixel LED 색상 설정- 추후 조건에 따라 함수화
    if (fTemperature >= 32)
    {
      redColor = 255;
      greenColor = 89;
      blueColor = 89;
    }
    else if (fTemperature >= 26)
    {
      redColor = 254;
      greenColor = 155;
      blueColor = 120;
    }
    else if (fTemperature >= 18)
    {
      redColor = 255;
      greenColor = 255;
      blueColor = 255;
    }
    else if (fTemperature >= 0)
    {
      redColor = 58;
      greenColor = 199;
      blueColor = 131;
    }
    else
    {
      redColor = 126;
      greenColor = 225;
      blueColor = 225;
    }

    myLEDStrip.neoPixelFill(redColor, greenColor, blueColor, true);
  }
}

// OLED 초기화 및 초기 화면 표시 함수
void initializeOLED()
{
  if (!myOledDisplay.begin(SSD1306_SWITCHCAPVCC, SCREEN_ADDRESS))
  {
#if (DEBUG_MODE_ENABLE == 1)
    Serial.println(F("SSD1306 allocation failed"));
#endif
    for (;;)
      ;
  }

  myOledDisplay.clearDisplay();
  myOledDisplay.drawBitmap(0, 0, epd_bitmap_oled_background, 128, 32, 1);
  myOledDisplay.display();

  previousMillis = millis();
}

// OLED에 온도, 습도, 조도 데이터 표시 함수
void displaySensorData(float temperature, float humidity, float lightLevel)
{
  myOledDisplay.clearDisplay();
  myOledDisplay.setTextSize(1);
  myOledDisplay.setTextColor(SSD1306_WHITE);
  myOledDisplay.setCursor(0, 0);

  myOledDisplay.print("Temp: ");
  myOledDisplay.print(temperature);
  myOledDisplay.print((char)247);
  myOledDisplay.println("C");

  myOledDisplay.print("Hum: ");
  myOledDisplay.print(humidity);
  myOledDisplay.println("%");

  myOledDisplay.print("Light: ");
  myOledDisplay.print(lightLevel);
  myOledDisplay.println(" lx");

  myOledDisplay.display();
}

// 현재 NeoPixel LED의 RGB 값을 HSV로 변환하여 클라우드로 전송하는 함수
void sendHSV_ColorDataToCloud(void)
{
  rgb_to_hsv(redColor, greenColor, blueColor);

  setRGBcolor.setHue(hue);
  setRGBcolor.setSaturation(saturation);
  setRGBcolor.setBrightness(value);
}

// RGB 값을 HSV로 변환하는 함수
void rgb_to_hsv(double r, double g, double b)
{
  r = r / 255.0;
  g = g / 255.0;
  b = b / 255.0;

  double cmax = max(r, max(g, b)); // r, g, b 중 최대값
  double cmin = min(r, min(g, b)); // r, g, b 중 최소값
  double diff = cmax - cmin;       // 최대값과 최소값의 차이
  hue = -1;
  saturation = -1;

  // Hue 계산
  if (cmax == cmin)
    hue = 0;
  else if (cmax == r)
    hue = fmod(60 * ((g - b) / diff) + 360, 360);
  else if (cmax == g)
    hue = fmod(60 * ((b - r) / diff) + 120, 360);
  else if (cmax == b)
    hue = fmod(60 * ((r - g) / diff) + 240, 360);

  // Saturation 계산
  if (cmax == 0)
    saturation = 0;
  else
    saturation = (diff / cmax) * 100;

  // Brightness (Value) 계산
  value = cmax * 100;
}